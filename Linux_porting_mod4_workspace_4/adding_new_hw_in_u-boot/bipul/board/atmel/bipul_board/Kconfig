## Linux_porting_mod4_workspace_4/adding_new_hw_in_u-boot/bipul/board/atmel/bipul_board/Kconfig
```kconfig
if TARGET_BIPUL_BOARD

config SYS_BOARD
	default "bipul_board"

config SYS_VENDOR
	default "atmel"

config SYS_SOC
	default "at91"

config SYS_CONFIG_NAME
	default "bipul_board"

endif
```
